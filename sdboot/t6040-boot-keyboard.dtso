/dts-v1/;
/plugin/;
/ {
 fragment@0 {
  target-path = "/soc";
  __overlay__ {
   #address-cells = <2>;
   #size-cells = <2>;
   boot_mtp_helper: m4rch-boot-mtp-helper@514600000 {
    compatible = "apple,rtk-helper-asc4";
    reg = <0x5 0x14600000 0 0x4000>, <0x5 0x14c00000 0 0xac000>;
    reg-names = "asc", "sram";
    mboxes = <0x5f>;
    status = "okay";
   };
   m4rch-boot-keyboard@514b34000 {
    compatible = "apple,dockchannel-hid";
    reg = <0x5 0x14b34000 0 0x1000>, <0x5 0x14b2c000 0 0x1000>;
    reg-names = "data", "rmt-data";
    apple,fifo-size = <0x800>;
    apple,helper-cpu = <&boot_mtp_helper>;
    status = "okay";
   };
  };
 };
};
