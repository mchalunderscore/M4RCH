// SPDX-License-Identifier: GPL-2.0-only
// Native boot ADT translates SGX reg[0] to 0x288000000 + 0x3758000.
// Expose only the prefix through the four proposed ID offsets. Disabled until
// an isolated preflight trial; no power-domain binding or access-review flag.
/ {
	m4rch_gpu_preflight: gpu-preflight@288000000 {
		compatible = "m4rch,t6040-gpu-identify";
		reg = <0x2 0x88000000 0x0 0xd04020>;
		reg-names = "sgx";
		status = "disabled";
	};
};
