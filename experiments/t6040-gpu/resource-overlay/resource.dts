/dts-v1/;
/plugin/;
/ {
    fragment@0 {
        target-path = "/";
        __overlay__ {
            m4rch-gpu-tests {
                compatible = "simple-bus";
                #address-cells = <2>;
                #size-cells = <2>;
                ranges;
                gpu-preflight@288000000 {
                    compatible = "m4rch,t6040-gpu-identify";
                    reg = <0x2 0x88000000 0x0 0xd04020>;
                    reg-names = "sgx";
                    status = "okay";
                };
            };
        };
    };
};
